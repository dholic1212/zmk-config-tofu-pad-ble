## config/boards/shields/klink_kbd/Kconfig.shield
```kconfig
# Copyright (c) 2020 The ZMK Contributors
# SPDX-License-Identifier: MIT

config SHIELD_TOFU_PAD_BLE
    def_bool $(shields_list_contains,tofu_pad_ble)
    select SPI
```
